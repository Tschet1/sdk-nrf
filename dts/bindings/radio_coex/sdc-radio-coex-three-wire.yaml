## dts/bindings/radio_coex/sdc-radio-coex-three-wire.yaml
```yaml
# Copyright (c) 2021 Nordic Semiconductor ASA
# SPDX-License-Identifier: LicenseRef-Nordic-5-Clause

description: |
    This is a representation of an external radio coexistence setup that has a
    three-pin control interface (REQUEST, GRANT, PRIORITY/DIRECTION). This
    extends that interface by adding additional parameters needed by the
    Softdevice Controller's implementation.

compatible: "sdc-radio-coex-three-wire"

include: generic-radio-coex-three-wire.yaml

properties:
    is-rx-active-level:
        type: int
        description: |
            Set to 0: TX direction is indicated by asserting the PRIORITY pin at
            the same level used for indicating a HIGH priority request.
            Set to 1: RX direction is indicated by asserting the PRIORITY pin at
            the same level used for indicating a HIGH priority request.

    type-delay-us:
        type: int
        description: |
            Delay in microseconds between the request pin being raised and the
            PRIORITY pin indicating the type of transaction (RX/TX).

    radio-delay-us:
        type: int
        description: |
            Delay in microseconds between the PRIORITY pin indicating the type
            of transaction and the radio starting on-air activity.
```
